/*定时器1做计数器，工作模式2，使用定时器0让LED1小灯100毫秒闪烁一次，
定时器1记录LED1闪烁次数，并且用数码管实时显示计数数值。

注意：必须用一根杜邦线把P10接到P35，数码管才会显示LED1闪烁次数

断开P10和P35的连接数码管计数停止，连接上数码管计数显示开始。
定时计数器1记录来自P10的脉冲。*/
#include <reg52.h>	//51头文件

#define uchar unsigned char	  //宏定义
#define uint  unsigned int	  //宏定义
sbit we = P2^7;	//位定义数码管位选锁存器接口
sbit du = P2^6;	 //位定义数码管位选锁存器接口
sbit LED1 = P1^0; //led1接口
//数码管段选表
uchar code leddata[]={ 
 
                0x3F,  //"0"
                0x06,  //"1"
                0x5B,  //"2"
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                0x00,  //熄灭
                0x00  //自定义
 
                         };
//毫秒级延时函数
void delay(uint z)
{
	uint x,y;
	for(x = z; x > 0; x--)
		for(y = 114; y > 0 ; y--);
}
//三位数码管动态显示函数
void display(uchar i)
{
	uchar bai, shi, ge;
	bai = i / 100; //显示百位
	shi = i % 100 / 10;	//显示十位
	ge  = i % 10;//显示个位

	P0 = 0xff; //清除断码
	we = 1;//打开位选
	P0 = 0xfe;//1111 1110 
	we = 0;	//关闭位选

	du = 1;	//打开段选
	P0 = leddata[bai];
	du = 0;	//关闭段选
	delay(5);//延时5毫秒
	
	P0 = 0xff;//清除断码
	we = 1;	//打开位选
	P0 = 0xfd;//1111 1101  
	we = 0;	//关闭位选
	
	du = 1;//打开段选
	P0 = leddata[shi]; 
	du = 0;	//关闭段选
	delay(5);//延时5毫秒
	
	P0 = 0xff;//清除断码
	we = 1;	//打开位选
	P0 = 0xfb;//1111 1011  
	we = 0;	//关闭位选
	
	du = 1;//打开段选
	P0 = leddata[ge]; 
	du = 0;	//关闭段选
	delay(5);//延时5毫秒	
}

void main()
{
		uchar a; //50次数计数
		TR0 = 1;//启动T0
		TR1 = 1;//启动T1
		TMOD = 0x61;//T0为定时器，工作模式1 16位计数器，T1为计数器，工作模式2，8位自动重装
		TH0 = 0x4b;
		TL0 = 0xfc;//0x4bfc	定时50ms
		TH1 = 20;//8位自动重装
		TL1 = 0;//当TL1溢出时自动装入TH1的值				
		while(1)
		{
			if(TF0 == 1)//判断T0是否溢出
			{
				TH0 = 0x4b;
				TL0 = 0xfc;//0x4bfc	定时50ms
				TF0 = 0;//清零便于下次判断
				a++;//50毫秒计数加1	
			}
			if(a == 2)//判断是否到100毫秒
			{
				a = 0;//清零便于下次记录50ms的次数
				LED1 = ~LED1;//闪烁LED1
			}			
			display(TL1);//显示T1计数值
		}
}